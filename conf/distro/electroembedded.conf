## conf/distro/electroembedded.conf
```bitbake
require conf/distro/poky.conf

DISTRO = "electroembedded"
DISTROOVERRIDES = "poky"
DISTRO_NAME = " electroembedded mp3 distribution "


# VC4DTBO_raspberrypi3 = "vc4-kms-v3d"


# configure our init system to use systemd
LICENSE_FLAGS_WHITELIST_append = " commercial_faad2"
VIRTUAL-RUNTIME_init_manager = "systemd"
VIRTUAL-RUNTIME_initscripts = "systemd-compat-units"
DISTRO_FEATURES_append = " systemd"
DISTRO_FEATURES_BACKFILL_CONSIDERED += "sysvinit"
INIT_MANAGER = "systemd"


# configure our hellopakgconfig to use feature1
# PACKAGECONFIG_append_pn-hellopakgconfig += " feature1"

PACKAGECONFIG_append_pn-qtbase += "gles2 gl eglfs directfb kms linuxfb wayland fontconfig"
PACKAGECONFIG_append_pn-qtmultimedia = " gstreamer alsa pulseaudio" 
PACKAGECONFIG_remove_pn-qtwayland = "xcomposite-glx"

PACKAGECONFIG_append_pn-pulseaudio = "systemd" 

LICENSE_FLAGS_WHITELIST_append = " commercial  \
                                   commercial_gstreamer1.0-plugins-ugly \
                                   commercial_gstreamer1.0-plugins-ugly"


MACHINE_EXTRA_RDEPENDS += "kernel-module-display"



# KERNEL_MODULE_AUTOLOAD += " hello"
```

## conf/layer.conf
```bitbake
# We have a conf and classes directory, add to BBPATH
BBPATH .= ":${LAYERDIR}"

# We have recipes-* directories, add to BBFILES
BBFILES += "${LAYERDIR}/recipes-*/*/*.bb \
            ${LAYERDIR}/recipes-*/*/*.bbappend"

BBFILE_COLLECTIONS += "meta-electroembeddedmp3"
BBFILE_PATTERN_meta-electroembeddedmp3 = "^${LAYERDIR}/"
BBFILE_PRIORITY_meta-electroembeddedmp3 = "6"

LAYERDEPENDS_meta-electroembeddedmp3 = "core"
LAYERSERIES_COMPAT_meta-electroembeddedmp3 = "dunfell"


# configure our init system to use systemd
LICENSE_FLAGS_WHITELIST_append = " commercial_faad2"
VIRTUAL-RUNTIME_init_manager = "systemd"
VIRTUAL-RUNTIME_initscripts = "systemd-compat-units"
DISTRO_FEATURES_append = " systemd"
DISTRO_FEATURES_BACKFILL_CONSIDERED += "sysvinit"
INIT_MANAGER = "systemd"


# configure our hellopakgconfig to use feature1
# PACKAGECONFIG_append_pn-hellopakgconfig += " feature1"

PACKAGECONFIG_append_pn-qtbase += "gles2 gl eglfs directfb kms linuxfb wayland fontconfig"
PACKAGECONFIG_append_pn-qtmultimedia = " gstreamer alsa" 
PACKAGECONFIG_remove_pn-qtwayland = "xcomposite-glx"

# CORE_IMAGE_EXTRA_INSTALL += " weston wayland "


MACHINE_EXTRA_RDEPENDS += "kernel-module-display"

# KERNEL_MODULE_AUTOLOAD += " hello"



























# KERNEL_MODULE_AUTOLOAD += " hello"
```
